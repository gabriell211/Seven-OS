## seven/Config.in
```kconfig
# Seven OS Buildroot external configuration.

menu "Seven OS"
source "$BR2_EXTERNAL_SEVEN_PATH/package/seven-desktop/Config.in"
source "$BR2_EXTERNAL_SEVEN_PATH/package/seven-core-apps/Config.in"
source "$BR2_EXTERNAL_SEVEN_PATH/package/seven-win/Config.in"
source "$BR2_EXTERNAL_SEVEN_PATH/package/seven-system-tools/Config.in"
endmenu
```

## seven/configs/seven_x86_64_defconfig
```kconfig
BR2_x86_64=y
BR2_TOOLCHAIN_BUILDROOT_GLIBC=y
BR2_TOOLCHAIN_BUILDROOT_CXX=y
BR2_GENERATE_LOCALE="C.UTF-8 en_US.UTF-8 pt_BR.UTF-8"

BR2_INIT_SYSTEMD=y
BR2_PACKAGE_SYSTEMD_DEFAULT_TARGET="graphical.target"
BR2_PACKAGE_SYSTEMD_LOGIND=y
BR2_PACKAGE_SYSTEMD_HOSTNAMED=y
BR2_PACKAGE_SYSTEMD_LOCALED=y
BR2_PACKAGE_SYSTEMD_RESOLVED=y
BR2_PACKAGE_POLKIT=y

BR2_TARGET_GENERIC_HOSTNAME="seven"
BR2_TARGET_GENERIC_ISSUE="Seven OS"
BR2_ROOTFS_DEVICE_CREATION_DYNAMIC_EUDEV=y
BR2_ROOTFS_OVERLAY="$(BR2_EXTERNAL_SEVEN_PATH)/board/seven/rootfs-overlay"

# The Seven kernel is built from the repository root, not by Buildroot.
# BR2_LINUX_KERNEL is not set

# Seven native system components.
BR2_PACKAGE_SEVEN_DESKTOP=y
BR2_PACKAGE_SEVEN_CORE_APPS=y
BR2_PACKAGE_SEVEN_WIN=y
BR2_PACKAGE_WINE=y

# Graphics and Qt.
BR2_PACKAGE_MESA3D=y
BR2_PACKAGE_MESA3D_GALLIUM_DRIVER_VIRGL=y
BR2_PACKAGE_MESA3D_GALLIUM_DRIVER_SOFTPIPE=y
BR2_PACKAGE_MESA3D_GALLIUM_DRIVER_CROCUS=y
BR2_PACKAGE_MESA3D_GALLIUM_DRIVER_NOUVEAU=y
BR2_PACKAGE_MESA3D_GALLIUM_DRIVER_RADEONSI=y
BR2_PACKAGE_MESA3D_LLVM=y
BR2_PACKAGE_MESA3D_GALLIUM_DRIVER_IRIS=y
BR2_PACKAGE_MESA3D_VULKAN_DRIVER_AMD=y
BR2_PACKAGE_MESA3D_VULKAN_DRIVER_INTEL=y
BR2_PACKAGE_MESA3D_OPENGL_EGL=y
BR2_PACKAGE_MESA3D_OPENGL_ES=y
BR2_PACKAGE_QT6=y
BR2_PACKAGE_QT6BASE_GUI=y
BR2_PACKAGE_QT6BASE_EGLFS=y
BR2_PACKAGE_QT6BASE_DEFAULT_QPA="eglfs"
BR2_PACKAGE_QT6BASE_OPENGL=y
BR2_PACKAGE_QT6BASE_OPENGL_ES2=y
BR2_PACKAGE_QT6BASE_NETWORK=y
BR2_PACKAGE_QT6BASE_DBUS=y
BR2_PACKAGE_QT6BASE_FONTCONFIG=y
BR2_PACKAGE_QT6DECLARATIVE=y
BR2_PACKAGE_QT6DECLARATIVE_QUICK=y
BR2_PACKAGE_QT6WAYLAND=y
BR2_PACKAGE_QT6WAYLAND_COMPOSITOR=y
BR2_PACKAGE_QT6SVG=y
BR2_PACKAGE_DEJAVU=y
BR2_PACKAGE_FOOT=y

# Networking.
BR2_PACKAGE_NETWORK_MANAGER=y
BR2_PACKAGE_NETWORK_MANAGER_CLI=y
BR2_PACKAGE_WPA_SUPPLICANT=y
BR2_PACKAGE_WPA_SUPPLICANT_DBUS=y
BR2_PACKAGE_WIRELESS_REGDB=y

# Audio.
BR2_PACKAGE_ALSA_LIB=y
BR2_PACKAGE_ALSA_UTILS=y
BR2_PACKAGE_PIPEWIRE=y
BR2_PACKAGE_LUA=y
BR2_PACKAGE_LUA_5_4=y
BR2_PACKAGE_WIREPLUMBER=y

# Kernel module runtime.
BR2_PACKAGE_BUSYBOX_SHOW_OTHERS=y

# Kernel module runtime.
BR2_PACKAGE_KMOD=y

# Kernel module runtime.
BR2_PACKAGE_KMOD_TOOLS=y

# Common PC firmware.
BR2_PACKAGE_LINUX_FIRMWARE=y
BR2_PACKAGE_LINUX_FIRMWARE_AMDGPU=y
BR2_PACKAGE_LINUX_FIRMWARE_RADEON=y
BR2_PACKAGE_LINUX_FIRMWARE_IWLWIFI_3160=y
BR2_PACKAGE_LINUX_FIRMWARE_IWLWIFI_3168=y
BR2_PACKAGE_LINUX_FIRMWARE_IWLWIFI_7260=y
BR2_PACKAGE_LINUX_FIRMWARE_IWLWIFI_7265D=y
BR2_PACKAGE_LINUX_FIRMWARE_IWLWIFI_8000C=y
BR2_PACKAGE_LINUX_FIRMWARE_IWLWIFI_8265=y
BR2_PACKAGE_LINUX_FIRMWARE_RTL_81XX=y
BR2_PACKAGE_LINUX_FIRMWARE_RTL_87XX=y
BR2_PACKAGE_LINUX_FIRMWARE_RTL_88XX=y
BR2_PACKAGE_LINUX_FIRMWARE_RTL_8169=y

# Developer initramfs plus persistent ext4 root image.
BR2_TARGET_ROOTFS_CPIO=y
BR2_TARGET_ROOTFS_CPIO_GZIP=y
BR2_TARGET_ROOTFS_EXT2=y
BR2_TARGET_ROOTFS_EXT2_4=y
BR2_TARGET_ROOTFS_EXT2_LABEL="SEVENROOT"
BR2_TARGET_ROOTFS_EXT2_SIZE="2048M"
# BR2_TARGET_ROOTFS_TAR is not set

# UEFI boot and image generation.
BR2_TARGET_GRUB2=y
BR2_TARGET_GRUB2_X86_64_EFI=y
BR2_PACKAGE_HOST_DOSFSTOOLS=y
BR2_PACKAGE_HOST_GENIMAGE=y
BR2_PACKAGE_HOST_MTOOLS=y
BR2_PACKAGE_WPA_SUPPLICANT_NL80211=y
BR2_PACKAGE_WPA_SUPPLICANT_WPA3=y
```

## seven/package/gtk-layer-shell/Config.in
```kconfig
config BR2_PACKAGE_GTK_LAYER_SHELL
	bool "gtk-layer-shell"
	depends on BR2_PACKAGE_LIBGTK3
	depends on BR2_PACKAGE_LIBGTK3_WAYLAND
	depends on !BR2_STATIC_LIBS
	select BR2_PACKAGE_WAYLAND
	select BR2_PACKAGE_WAYLAND_PROTOCOLS
	help
	  GTK3 library implementing the Wayland layer-shell protocol.
	  Seven Shell uses it for the desktop background, panel and launcher.
```

## seven/package/seven-apps/Config.in
```kconfig
config BR2_PACKAGE_SEVEN_APPS
	bool "Seven core desktop applications"
	depends on BR2_PACKAGE_SEVEN_DESKTOP
	select BR2_PACKAGE_QT6BASE_GUI
	select BR2_PACKAGE_QT6BASE_NETWORK
	select BR2_PACKAGE_QT6DECLARATIVE
	select BR2_PACKAGE_QT6DECLARATIVE_QUICK
	select BR2_PACKAGE_FOOT
	help
	  Core Seven applications: Files, Settings, Store, System Monitor
	  and the Seven Terminal launcher.
```

## seven/package/seven-core-apps/Config.in
```kconfig
config BR2_PACKAGE_SEVEN_CORE_APPS
	bool "Seven core desktop applications"
	depends on BR2_PACKAGE_SEVEN_DESKTOP
	select BR2_PACKAGE_QT6
	select BR2_PACKAGE_QT6BASE_GUI
	select BR2_PACKAGE_QT6DECLARATIVE
	select BR2_PACKAGE_QT6DECLARATIVE_QUICK
	help
	  Native Seven OS Wayland applications:
	  Files, Settings and System Monitor.
```

## seven/package/seven-desktop/Config.in
```kconfig
config BR2_PACKAGE_SEVEN_DESKTOP
	bool "Seven Desktop"
	depends on BR2_x86_64
	depends on BR2_INSTALL_LIBSTDCPP
	depends on BR2_TOOLCHAIN_HAS_THREADS
	depends on !BR2_STATIC_LIBS
	select BR2_PACKAGE_QT6
	select BR2_PACKAGE_QT6BASE_GUI
	select BR2_PACKAGE_QT6BASE_OPENGL
	select BR2_PACKAGE_QT6BASE_OPENGL_ES2
	select BR2_PACKAGE_QT6BASE_NETWORK
	select BR2_PACKAGE_QT6DECLARATIVE
	select BR2_PACKAGE_QT6DECLARATIVE_QUICK
	select BR2_PACKAGE_QT6WAYLAND
	select BR2_PACKAGE_QT6WAYLAND_COMPOSITOR
	select BR2_PACKAGE_QT6SVG
	help
	  Seven OS native Wayland compositor and desktop shell.

	  Provides the Seven sidebar, status bar, dock, desktop widgets,
	  client window area and the visual language used by the system.
```

## seven/package/seven-system-tools/Config.in
```kconfig
config BR2_PACKAGE_SEVEN_SYSTEM_TOOLS
	bool "Seven system, recovery and installation tools"
	select BR2_PACKAGE_COREUTILS
	select BR2_PACKAGE_FOOT
	select BR2_PACKAGE_UTIL_LINUX
	select BR2_PACKAGE_UTIL_LINUX_BINARIES
	select BR2_PACKAGE_UTIL_LINUX_MOUNT
	select BR2_PACKAGE_PARTED
	select BR2_PACKAGE_E2FSPROGS
	select BR2_PACKAGE_E2FSPROGS_RESIZE2FS
	help
	  Diagnostics, recovery utilities and guarded disk-image installer
	  for Seven OS.
```

## seven/package/seven-win/Config.in
```kconfig
config BR2_PACKAGE_SEVEN_WIN
	bool "Seven Windows compatibility layer"
	depends on BR2_x86_64
	depends on !BR2_STATIC_LIBS
	depends on BR2_TOOLCHAIN_HAS_THREADS_NPTL
	select BR2_PACKAGE_WINE
	help
	  Installs the Seven Windows compatibility integration layer.

	  seven-win provides the Seven WinExec launcher, isolated Wine
	  prefixes per application, MSI routing and binfmt_misc registration
	  for Windows PE executables.

	  Wine 11 is built into the Seven image as the initial Windows runtime.
```
